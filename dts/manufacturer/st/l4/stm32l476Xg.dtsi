/*
 * Copyright (c) 2018 Linaro Limited
 *
 * SPDX-License-Identifier: Apache-2.0
 */
#include <mem.h>
#include <st/l4/stm32l476.dtsi>

&sram0 {
	compatible = "mmio-sram";
	reg = <0x20000000 DT_SIZE_K(96)>;
};

&flash0 {
   reg = <0x08000000 DT_SIZE_K(2048)>;
};
